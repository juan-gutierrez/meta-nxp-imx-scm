## conf/machine/imx6dqscm-1gb-evb.conf
```bitbake
#@TYPE: Machine
#@NAME: Freescale i.MX6QSCM EVB
#@SOC: i.MX6Q
#@DESCRIPTION: Machine configuration for Freescale i.MX6SCM EVB
#@MAINTAINER: Alejandro Sierra <alejandro.guiza@nxp.com>

require conf/machine/include/imx6sabresd-common.inc

SOC_FAMILY = "mx6:mx6q"

KERNEL_DEVICETREE = "imx6dqscm-1gb-evb-fix-ldo.dtb imx6dqscm-1gb-evb-hdcp-fix-ldo.dtb  \
                     imx6dqscm-1gb-evb-enetirq-fix-ldo.dtb imx6dqscm-1gb-evb-btwifi-fix-ldo.dtb"

UBOOT_CONFIG ??= "sd"
UBOOT_CONFIG[sd] = "mx6dqscm_1gb_fix_evb_defconfig,sdcard"
UBOOT_CONFIG[mfgtool] = "mx6dqscm_1gb_fix_evb_defconfig"
UBOOT_CONFIG[spinor] = "mx6dqscm_1gb_fix_evb_spinor_defconfig"
```

## conf/machine/imx6dqscm-2gb-evb.conf
```bitbake
#@TYPE: Machine
#@NAME: Freescale i.MX6QSCM EVB
#@SOC: i.MX6Q
#@DESCRIPTION: Machine configuration for Freescale i.MX6SCM EVB
#@MAINTAINER: Alejandro Sierra <alejandro.guiza@nxp.com>

require conf/machine/include/imx6sabresd-common.inc

SOC_FAMILY = "mx6:mx6q"

KERNEL_DEVICETREE = "imx6dqscm-2gb-evb-fix-ldo.dtb imx6dqscm-2gb-evb-hdcp-fix-ldo.dtb  \
                     imx6dqscm-2gb-evb-enetirq-fix-ldo.dtb imx6dqscm-2gb-evb-btwifi-fix-ldo.dtb"

UBOOT_CONFIG ??= "sd"
UBOOT_CONFIG[sd] = "mx6dqscm_2gb_fix_evb_defconfig,sdcard"
UBOOT_CONFIG[mfgtool] = "mx6dqscm_2gb_fix_evb_defconfig"
UBOOT_CONFIG[spinor] = "mx6dqscm_2gb_fix_evb_spinor_defconfig"
```

## conf/machine/imx6dqscm-epop-qwks.conf
```bitbake
#@TYPE: Machine
#@NAME: Freescale i.MX6QSCM EVB
#@SOC: i.MX6Q
#@DESCRIPTION: Machine configuration for Freescale i.MX6SCM EVB
#@MAINTAINER: Alejandro Sierra <alejandro.guiza@nxp.com>

require conf/machine/include/imx6sabresd-common.inc

SOC_FAMILY = "mx6:mx6q"

KERNEL_DEVICETREE = "imx6dqscm-512mb-qwks-rev2-fix-ldo.dtb imx6dqscm-512mb-qwks-rev2-hdcp-fix-ldo.dtb imx6dqscm-512mb-qwks-rev2-wifi-fix-ldo.dtb"

UBOOT_CONFIG ??= "sd"
UBOOT_CONFIG[sd] = "mx6dqscm_512mb_qwks_rev2_defconfig,sdcard"
UBOOT_CONFIG[mfgtool] = "mx6dqscm_512mb_qwks_rev2_defconfig"
UBOOT_CONFIG[spinor] = "mx6dqscm_512mb_qwks_rev2_spinor_defconfig"
```

## conf/machine/imx6sxscm-1gb-evb.conf
```bitbake
#@TYPE: Machine
#@NAME: Freescale i.MX6SXSCM EVB
#@SOC: i.MX6SX
#@DESCRIPTION: Machine configuration for Freescale i.MX6SCM EVB
#@MAINTAINER: Alejandro Sierra <alejandro.guiza@nxp.com>

require conf/machine/include/imx6sabresd-common.inc

SOC_FAMILY = "mx6:mx6sx"

KERNEL_DEVICETREE = "imx6sxscm-1gb-evb-ldo.dtb \
                     imx6sxscm-1gb-evb-lcdif1-ldo.dtb \
                     imx6sxscm-1gb-evb-m4-ldo.dtb \
                     imx6sxscm-1gb-evb-mqs-ldo.dtb \
                     imx6sxscm-1gb-evb-sai-ldo.dtb \
		     imx6sxscm-1gb-evb-btwifi-ldo.dtb "

UBOOT_CONFIG ??= "sd"
UBOOT_CONFIG[sd] = "mx6sxscm_1gb_evb_defconfig,sdcard"
UBOOT_CONFIG[qspi2] = "mx6sxscm_1gb_evb_qspi2_defconfig"
UBOOT_CONFIG[m4fastup] = "mx6sxscm_1gb_evb_m4fastup_defconfig"
UBOOT_CONFIG[mfgtool] = "mx6sxscm_1gb_evb_defconfig"
```

## conf/machine/imx6sxscm-epop-evb.conf
```bitbake
#@TYPE: Machine
#@NAME: Freescale i.MX6SXSCM EVB
#@SOC: i.MX6SX
#@DESCRIPTION: Machine configuration for Freescale i.MX6SCM EVB
#@MAINTAINER: Alejandro Sierra <alejandro.guiza@nxp.com>

require conf/machine/include/imx6sabresd-common.inc

SOC_FAMILY = "mx6:mx6sx"

KERNEL_DEVICETREE = "imx6sxscm-epop-evb-ldo.dtb \
                     imx6sxscm-epop-evb-lcdif1-ldo.dtb \
                     imx6sxscm-epop-evb-m4-ldo.dtb \
                     imx6sxscm-epop-evb-mqs-ldo.dtb \
                     imx6sxscm-epop-evb-sai-ldo.dtb \
		     imx6sxscm-epop-evb-btwifi-ldo.dtb "

UBOOT_CONFIG ??= "sd"
UBOOT_CONFIG[sd] = "mx6sxscm_epop_evb_defconfig,sdcard"
UBOOT_CONFIG[qspi2] = "mx6sxscm_epop_evb_qspi2_defconfig"
UBOOT_CONFIG[m4fastup] = "mx6sxscm_epop_evb_m4fastup_defconfig"
UBOOT_CONFIG[mfgtool] = "mx6sxscm_epop_evb_defconfig"
```
